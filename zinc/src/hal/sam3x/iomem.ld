PROVIDE(isr_supc = isr_dummy_handler);
PROVIDE(isr_rstc = isr_dummy_handler);
PROVIDE(isr_rtc = isr_dummy_handler);
PROVIDE(isr_rtt = isr_dummy_handler);
PROVIDE(isr_wdt = isr_dummy_handler);
PROVIDE(isr_pmc = isr_dummy_handler);
PROVIDE(isr_efc0 = isr_dummy_handler);
PROVIDE(isr_efc1 = isr_dummy_handler);
PROVIDE(isr_uart = isr_dummy_handler);
PROVIDE(isr_smc = isr_dummy_handler);
PROVIDE(isr_dramc = isr_dummy_handler);
PROVIDE(isr_pioa = isr_dummy_handler);
PROVIDE(isr_piob = isr_dummy_handler);
PROVIDE(isr_pioc = isr_dummy_handler);
PROVIDE(isr_piod = isr_dummy_handler);
PROVIDE(isr_pioe = isr_dummy_handler);
PROVIDE(isr_piof = isr_dummy_handler);
PROVIDE(isr_usart0 = isr_dummy_handler);
PROVIDE(isr_usart1 = isr_dummy_handler);
PROVIDE(isr_usart2 = isr_dummy_handler);
PROVIDE(isr_usart3 = isr_dummy_handler);
PROVIDE(isr_hsmci = isr_dummy_handler);
PROVIDE(isr_twi0 = isr_dummy_handler);
PROVIDE(isr_twi1 = isr_dummy_handler);
PROVIDE(isr_spi0 = isr_dummy_handler);
PROVIDE(isr_spi1 = isr_dummy_handler);
PROVIDE(isr_ssc = isr_dummy_handler);
PROVIDE(isr_tc0 = isr_dummy_handler);
PROVIDE(isr_tc1 = isr_dummy_handler);
PROVIDE(isr_tc2 = isr_dummy_handler);
PROVIDE(isr_tc3 = isr_dummy_handler);
PROVIDE(isr_tc4 = isr_dummy_handler);
PROVIDE(isr_tc5 = isr_dummy_handler);
PROVIDE(isr_tc6 = isr_dummy_handler);
PROVIDE(isr_tc7 = isr_dummy_handler);
PROVIDE(isr_tc8 = isr_dummy_handler);
PROVIDE(isr_pwm = isr_dummy_handler);
PROVIDE(isr_adc = isr_dummy_handler);
PROVIDE(isr_dacc = isr_dummy_handler);
PROVIDE(isr_dmac = isr_dummy_handler);
PROVIDE(isr_utoghs = isr_dummy_handler);
PROVIDE(isr_trng = isr_dummy_handler);
PROVIDE(isr_emac = isr_dummy_handler);
PROVIDE(isr_can0 = isr_dummy_handler);
PROVIDE(isr_can1 = isr_dummy_handler);

sam3x_iomem_PIOA = 0x400E0E00;
sam3x_iomem_PIOB = 0x400E1000;
sam3x_iomem_PIOC = 0x400E1200;
sam3x_iomem_PIOD = 0x400E1400;
sam3x_iomem_PIOE = 0x400E1600;
sam3x_iomem_PIOF = 0x400E1800;
sam3x_iomem_PMC = 0x400E0600;
sam3x_iomem_EEFC0 = 0x400E0A00;
sam3x_iomem_EEFC1 = 0x400E0C00;
sam3x_iomem_WDC = 0x400E1A50;
sam3x_iomem_TC0 = 0x40080000;
sam3x_iomem_TC1 = 0x40084000;
sam3x_iomem_TC2 = 0x40088000;
sam3x_iomem_SCB = 0xE000ED00;
